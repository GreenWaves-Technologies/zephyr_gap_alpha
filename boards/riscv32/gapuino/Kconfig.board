## boards/riscv32/gapuino/Kconfig.board
```kconfig
config BOARD_GAPUINO
	bool "Gapuino target"
	depends on SOC_RISCV32_GAP8
	select HAS_DTS
```

## boards/riscv32/gapuino/gapuino_defconfig
```kconfig
CONFIG_RISCV32=y
CONFIG_SOC_SERIES_RISCV32_GAP8=y
CONFIG_SOC_RISCV32_GAP8=y
CONFIG_BOARD_GAPUINO=y
CONFIG_CONSOLE=y
CONFIG_PRINTK=y
CONFIG_SERIAL=y
CONFIG_STDOUT_CONSOLE=y
CONFIG_UART_CONSOLE=y
CONFIG_UART_PULP_PORT_NAME="UART_0"
CONFIG_PULP_TIMER_V2=y
CONFIG_GPIO=y
CONFIG_GPIO_GAP=y
CONFIG_BOOT_BANNER=y
```

## drivers/serial/Kconfig.pulp_uart_v1
```kconfig
# Kconfig.riscv_qemu - riscv-qemu UART configuration option
#
# Copyright (c) 2016 Jean-Paul Etienne <fractalclone@gmail.com>
#
# SPDX-License-Identifier: Apache-2.0
#

menuconfig UART_PULP_UART_V1
	bool "pulp udma v1 UART driver"  
	select SERIAL_HAS_DRIVER
	help
	  Enable the pulp udma v1 UART driver.

menuconfig UART_PULP_PORT
        bool "Enable Pulp Port 0"
        default y
        depends on UART_PULP_UART_V1
        help
          This tells the driver to configure the UART port at boot, depending on
          the additional configure options below.

config UART_PULP_PORT_NAME
        string "UART Device Name"
        default "UART_0"
        depends on UART_PULP_PORT
        help
          This is the device name for UART, and is included in the device
          struct.
```

## dts/bindings/serial/pulp_uart_v1.yaml
```yaml
---
title: pulp_uart_v1
version: 0.1

description: >
    This binding gives a base representation of the Pulp UDMA UART

inherits:
    !include uart.yaml

properties:
    compatible:
      constraint: "pulp_uart_v1"

...
```

## soc/riscv32/gap/Kconfig.soc
```kconfig
config SOC_RISCV32_GAP
	bool "Gap SOC implementation"
	select ATOMIC_OPERATIONS_C
```

## soc/riscv32/pulpv4/Kconfig
```kconfig
config SOC_FAMILY_PULPV4
	bool
	# omit prompt to signify a "hidden" option

config SOC_FAMILY
	string
	default "pulpv4"
	depends on SOC_FAMILY_PULPV4

source "soc/riscv32/pulpv4/*/Kconfig.soc"
```

## soc/riscv32/pulpv4/Kconfig.defconfig
```kconfig
source "soc/riscv32/pulpv4/*/Kconfig.defconfig.series"

config CHECK_LINK_MAP
        default n
```

## soc/riscv32/pulpv4/gap8/Kconfig.defconfig.series
```kconfig
if SOC_SERIES_RISCV32_GAP8

config SOC_SERIES
	string
	default "gap8"
config SOC
	string
	default "gap"

config SYS_CLOCK_HW_CYCLES_PER_SEC
	int
	default 5000000

config RISCV_SOC_CONTEXT_SAVE
	bool
	default y

config RISCV_SOC_INTERRUPT_INIT
	bool
	default y

config RISCV_HAS_CPU_IDLE
	bool
	default y

config INCLUDE_RESET_VECTOR
	bool
	default y

config NUM_IRQS
	int
	default 32

config L2_BASE_ADDRESS
	hex
	default	0x1c000000

config L2_SIZE
	hex
	default 0x80000

config FC_TCDM_BASE_ADDRESS
	hex
	default 0x1b000000

config FC_TCDM_SIZE
	hex
	default 0x4000


endif # SOC_SERIES_RISCV32_GAP8
```

## soc/riscv32/pulpv4/gap8/Kconfig.series
```kconfig
config SOC_SERIES_RISCV32_GAP8
	bool "GAP8 SOC implementation"
	depends on RISCV32
	select SOC_FAMILY_PULPV4
	help
	  Enable support for GAP8 SOC
```

## soc/riscv32/pulpv4/gap8/Kconfig.soc
```kconfig
choice
prompt "GAP8 SOC implementation"
depends on SOC_SERIES_RISCV32_GAP8

config SOC_RISCV32_GAP8
	bool "GAP8 SOC implementation"
	select ATOMIC_OPERATIONS_C

endchoice
```
